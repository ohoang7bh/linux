// SPDX-License-Identifier: (GPL-2.0+ OR MIT)
/*
 * Copyright (c) 2018 BayLibre SAS. All rights reserved.
 */

/dts-v1/;

#include <dt-bindings/leds/common.h>

/ {
	compatible = "radxa,zero", "amlogic,g12a";
	model = "Radxa Zero";

	leds {
		compatible = "gpio-leds";

		led-green {
			color = <LED_COLOR_ID_GREEN>;
			function = LED_FUNCTION_POWER;
			gpios = <&gpio_ao GPIOAO_8 GPIO_ACTIVE_HIGH>;
			linux,default-trigger = "heartbeat";
			default-state = "on";
		};
	};
};
